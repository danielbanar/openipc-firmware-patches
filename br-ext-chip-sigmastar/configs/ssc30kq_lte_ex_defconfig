## br-ext-chip-sigmastar/configs/ssc30kq_lte_ex_defconfig
```kconfig
# Architecture
BR2_arm=y
BR2_cortex_a7=y
BR2_ARM_FPU_NEON_VFPV4=y
BR2_ARM_INSTRUCTIONS_THUMB2=y

# Toolchain
BR2_TOOLCHAIN_EXTERNAL=y
BR2_TOOLCHAIN_EXTERNAL_CUSTOM=y
BR2_TOOLCHAIN_EXTERNAL_DOWNLOAD=y
BR2_TOOLCHAIN_EXTERNAL_URL="https://github.com/openipc/firmware/releases/download/$(OPENIPC_TOOLCHAIN).tgz"
BR2_TOOLCHAIN_EXTERNAL_CUSTOM_PREFIX="arm-openipc-linux-gnueabihf"
BR2_TOOLCHAIN_EXTERNAL_HEADERS_4_9=y
BR2_TOOLCHAIN_EXTERNAL_CUSTOM_GLIBC=y
# BR2_TOOLCHAIN_EXTERNAL_INET_RPC is not set
BR2_TOOLCHAIN_EXTERNAL_CXX=y

# Kernel
BR2_LINUX_KERNEL=y
BR2_LINUX_KERNEL_CUSTOM_TARBALL=y
BR2_LINUX_KERNEL_CUSTOM_TARBALL_LOCATION="https://github.com/openipc/linux/archive/$(OPENIPC_KERNEL).tar.gz"
BR2_LINUX_KERNEL_USE_CUSTOM_CONFIG=y
BR2_LINUX_KERNEL_CUSTOM_CONFIG_FILE="$(EXTERNAL_VENDOR)/board/$(OPENIPC_SOC_FAMILY)/infinity6e-ssc012b.config"
BR2_LINUX_KERNEL_UIMAGE=y
BR2_LINUX_KERNEL_XZ=y

# Filesystem
BR2_PACKAGE_BUSYBOX_CONFIG="$(BR2_EXTERNAL)/package/busybox/busybox.config"
BR2_PACKAGE_EXFATPROGS=y
BR2_PACKAGE_UBOOT_TOOLS=y
BR2_PACKAGE_ZLIB=y
# BR2_PACKAGE_IFUPDOWN_SCRIPTS is not set
BR2_PACKAGE_WIRELESS_TOOLS=y
BR2_TARGET_ROOTFS_CPIO=y
BR2_TARGET_ROOTFS_SQUASHFS=y
BR2_TARGET_ROOTFS_SQUASHFS4_XZ=y

# OpenIPC
BR2_OPENIPC_SOC_VENDOR="sigmastar"
BR2_OPENIPC_SOC_MODEL="ssc30kq"
BR2_OPENIPC_SOC_FAMILY="infinity6e"
BR2_OPENIPC_VARIANT="fpv"
BR2_OPENIPC_FLASH_SIZE="16"
BR2_OPENIPC_KERNEL_SIZE="2048"
BR2_OPENIPC_ROOTFS_SIZE="10240"

# Packages
BR2_PACKAGE_DROPBEAR_OPENIPC=y
BR2_PACKAGE_EXFAT_OPENIPC=y
BR2_PACKAGE_IPCTOOL=y
BR2_PACKAGE_JSONFILTER=y
BR2_PACKAGE_LIBCURL_OPENIPC=y
BR2_PACKAGE_LIBCURL_OPENIPC_CURL=y
# BR2_PACKAGE_LIBCURL_OPENIPC_PROXY_SUPPORT is not set
# BR2_PACKAGE_LIBCURL_OPENIPC_COOKIES_SUPPORT is not set
# BR2_PACKAGE_LIBCURL_OPENIPC_EXTRA_PROTOCOLS_FEATURES is not set
BR2_PACKAGE_LIBOGG_OPENIPC=y
BR2_PACKAGE_MAJESTIC_FONTS=y
BR2_PACKAGE_MAJESTIC_WEBUI=y
BR2_PACKAGE_MAJESTIC=y
BR2_PACKAGE_MAVFWD=y
BR2_PACKAGE_MBEDTLS_OPENIPC=y
#BR2_PACKAGE_MSPOSD=y
BR2_PACKAGE_OPUS_OPENIPC=y
BR2_PACKAGE_OPUS_OPENIPC_FIXED_POINT=y
#BR2_PACKAGE_RTL88X2EU_OPENIPC=y
#BR2_PACKAGE_RTL8812AU_OPENIPC=y
BR2_PACKAGE_SIGMASTAR_OSDRV_INFINITY6E=y
BR2_PACKAGE_VTUND_OPENIPC=y
#BR2_PACKAGE_WIFIBROADCAST=y
BR2_PACKAGE_YAML_CLI=y
BR2_PACKAGE_WIREGUARD_LINUX_COMPAT=y
BR2_PACKAGE_WIREGUARD_TOOLS=y
BR2_PACKAGE_WIREGUARD_DB=y
BR2_PACKAGE_MASINA_CLIENT_DB=y
BR2_PACKAGE_THERMAL_THROTTLE_DB=y
BR2_PACKAGE_FAKE_HWCLOCK=y
BR2_PACKAGE_USB_MODESWITCH=y
BR2_PACKAGE_USB_MODESWITCH_DATA=y
BR2_PACKAGE_SOCAT=y

# Tools
BR2_PACKAGE_NANO=y
BR2_PACKAGE_MINICOM=y
BR2_PACKAGE_BMON=y

# FFMPEG
BR2_PACKAGE_FFMPEG_ARCH_SUPPORTS=y
BR2_PACKAGE_FFMPEG=y
BR2_PACKAGE_FFMPEG_GPL=y      # Needed for MKV/MP4 muxers and libx265
BR2_PACKAGE_FFMPEG_NONFREE=n  # Not needed
BR2_PACKAGE_FFMPEG_FFMPEG=y
BR2_PACKAGE_FFMPEG_FFPLAY=n   # Not needed
BR2_PACKAGE_FFMPEG_FFPROBE=n  # Not needed
BR2_PACKAGE_FFMPEG_AVRESAMPLE=n  # Not needed
BR2_PACKAGE_FFMPEG_SWSCALE=n     # Not needed
BR2_PACKAGE_FFMPEG_ENCODERS=""
BR2_PACKAGE_FFMPEG_DECODERS="hevc,h264" # H.265 for stream, H.264 optional if camera streams it
BR2_PACKAGE_FFMPEG_MUXERS="matroska,mov,segment"  # MKV and MP4 containers
BR2_PACKAGE_FFMPEG_DEMUXERS="rtsp,h264,hevc"  # RTSP input and video codecs
BR2_PACKAGE_FFMPEG_PARSERS="hevc,h264"  # Needed for decoding
BR2_PACKAGE_FFMPEG_BSFS="all"    # Needed for copy stream
BR2_PACKAGE_FFMPEG_PROTOCOLS="file,rtsp,tcp"  # RTSP input and file output
BR2_PACKAGE_FFMPEG_FILTERS=n     # Not needed
BR2_PACKAGE_FFMPEG_INDEVS=n      # Not needed
BR2_PACKAGE_FFMPEG_OUTDEVS=n     # Not needed
BR2_PACKAGE_FFMPEG_EXTRACONF="" # Not needed
```

## general/package/autodelete-db/Config.in
```kconfig
config BR2_PACKAGE_AUTODELETE_DB
	bool "autodelete-db"
	help
	  Removes old files on drive/directory when usage exceeds a some percentage.
```
